## firmware/main/Kconfig.projbuild
```kconfig
menu "Sirokko local panel"
    config SIROKKO_PANEL_WIDTH
        int "Native TFT width (pixels)"
        range 1 320
        default 240
    config SIROKKO_PANEL_HEIGHT
        int "Native TFT height (pixels)"
        range 1 320
        default 320
    config SIROKKO_PANEL_ROTATION
        int "Rotation (0, 90, 180 or 270 degrees)"
        range 0 270
        default 90
        help
            Approved UI is landscape 320x240. With native 240x320, select 90 or 270.
            Other logical sizes are rejected; safety control remains independent.
    config SIROKKO_PANEL_X_GAP
        int "Controller X offset (pixels)"
        range 0 320
        default 0
    config SIROKKO_PANEL_Y_GAP
        int "Controller Y offset (pixels)"
        range 0 320
        default 0
    config SIROKKO_PANEL_INVERT
        bool "Invert ST7789 colors"
        default y
endmenu
```

## firmware/sdkconfig.defaults
```kconfig
CONFIG_IDF_TARGET="esp32s3"
CONFIG_ESPTOOLPY_FLASHSIZE_16MB=y
CONFIG_ESPTOOLPY_FLASHSIZE="16MB"
CONFIG_ESPTOOLPY_FLASHMODE_QIO=y
CONFIG_SPIRAM=y
CONFIG_SPIRAM_MODE_OCT=y
CONFIG_SPIRAM_SPEED_80M=y
CONFIG_SPIRAM_BOOT_INIT=y
CONFIG_SPIRAM_ALLOW_BSS_SEG_EXTERNAL_MEMORY=y
CONFIG_ESP_DEFAULT_CPU_FREQ_MHZ_240=y
CONFIG_COMPILER_OPTIMIZATION_SIZE=y
CONFIG_COMPILER_OPTIMIZATION_ASSERTIONS_ENABLE=y
CONFIG_COMPILER_STACK_CHECK_MODE_STRONG=y
CONFIG_COMPILER_CXX_EXCEPTIONS=n
CONFIG_ESP_CONSOLE_USB_CDC=y
CONFIG_ESP_CONSOLE_SECONDARY_NONE=y
CONFIG_PARTITION_TABLE_CUSTOM=y
CONFIG_PARTITION_TABLE_CUSTOM_FILENAME="partitions.csv"
CONFIG_PARTITION_TABLE_FILENAME="partitions.csv"
CONFIG_BOOTLOADER_WDT_ENABLE=y
CONFIG_BOOTLOADER_WDT_TIME_MS=9000
CONFIG_ESP_INT_WDT=y
CONFIG_ESP_INT_WDT_TIMEOUT_MS=300
CONFIG_ESP_TASK_WDT_EN=y
CONFIG_ESP_TASK_WDT_INIT=y
CONFIG_ESP_TASK_WDT_TIMEOUT_S=2
CONFIG_ESP_TASK_WDT_PANIC=y
CONFIG_BOOTLOADER_APP_ROLLBACK_ENABLE=y
CONFIG_LOG_DEFAULT_LEVEL_INFO=y
CONFIG_FREERTOS_HZ=1000
CONFIG_FREERTOS_CHECK_STACKOVERFLOW_CANARY=y
CONFIG_FREERTOS_WATCHPOINT_END_OF_STACK=y

# Mobile browser headers exceed the IDF 512-byte default.
CONFIG_HTTPD_MAX_REQ_HDR_LEN=8192

# Initialization includes the local panel and its state snapshots.
CONFIG_ESP_MAIN_TASK_STACK_SIZE=8192
```
